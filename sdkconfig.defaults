## sdkconfig.defaults
```kconfig
# ESP-IDF configuration for NAT/NAPT support
# This file is used by PlatformIO to configure the ESP-IDF build

# Enable IP forwarding (required for routing between interfaces)
CONFIG_LWIP_IP_FORWARD=y

# Enable NAPT (Network Address Port Translation)
CONFIG_LWIP_IPV4_NAPT=y

# NAPT table size - number of concurrent connections to track
CONFIG_LWIP_NAPT_MAX=1000

# Enable L2-to-L3 forwarding
CONFIG_LWIP_L2_TO_L3_COPY=y

# DNS configuration  
CONFIG_LWIP_DNS_SUPPORT_MDNS_QUERIES=y
```
